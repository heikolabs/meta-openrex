## conf/machine/imx6s-openrex.conf
```bitbake
#@TYPE: Machine
#@NAME: HEIKOLABS i.MX6S OpenRex
#@SOC: i.MX6S
#@DESCRIPTION: Machine configuration for HEIKOLABS i.MX6 SOLO OpenRex
#@MAINTAINER: Heiko Pikner <heikopikner@gmail.com>
 
require conf/machine/include/imx6openrex-common.inc
 
SOC_FAMILY = "mx6:mx6dl"
 
PREFERRED_PROVIDER_u-boot_mx6 = "u-boot-openrex"
PREFERRED_PROVIDER_virtual/kernel_mx6 = "linux-openrex"
PREFERRED_VERSION_linux-openrex ?= "3.14"
 
KERNEL_DEVICETREE = "imx6s-openrex.dtb"
 
UBOOT_CONFIG ??= "sd"
UBOOT_CONFIG[sd] = "mx6sopenrex_config,sdcard"
UBOOT_CONFIG[mfgtool] = "mx6sopenrex_config"
```
